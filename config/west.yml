## config/west.yml
```yaml
manifest:
  remotes:
    - name: zmkfirmware
      url-base: https://github.com/zmkfirmware
    - name: eyelash
      url-base: https://github.com/a741725193

  projects:
    - name: zmk
      remote: zmkfirmware
      revision: main
      import: app/west.yml
    - name: eyelash_corne
      remote: eyelash
      revision: main
      path: modules/eyelash_corne

  self:
    path: config
```
